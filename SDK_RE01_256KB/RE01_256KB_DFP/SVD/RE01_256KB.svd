# RE01_256KB register map
Vendor: Renesas Electronics Corporation; Series: RE01; File version: 1.00.01
Arm Cortex-M0+ based MCU device
CPU: CM0PLUS r0p1, little endian, MPU, no FPU, VTOR, 2 interrupt priority bits, 32 interrupts
Registers are 8-bit, read-write, reset 0x0 unless marked. A register's access mark holds for its fields unless they carry their own. Offsets are from the block's base; lines under a group give offsets from that group; [hi:lo] are bit positions; {n}, {i} and the like mark numbered series; 'fields as' and 'values as' point back to an identical list; <NAME> marks a mode.

## Memory map
0x40000000 RMPU blocks up to offset 0xD20 — Renesas Memory Protection Unit
0x40001000 MMF size 0x8 — Memory Mirror Function
0x40003000 BUS blocks up to offset 0x1835 — BUS Control
0x40005000 DMAC0 blocks up to offset 0x1F — Direct memory access controller 0
0x40005040 DMAC1 blocks up to offset 0x1F — Direct memory access controller 1
0x40005080 DMAC2 blocks up to offset 0x1F — Direct memory access controller 2
0x400050C0 DMAC3 blocks up to offset 0x1F — Direct memory access controller 3
0x40005200 DMA size 0x1 — DMAC Module Activation
0x40005400 DTC blocks up to offset 0x10 — Data Transfer Controller
0x40006000 ICU blocks up to offset 0x380 — Interrupt Controller
0x4001B000 DBG blocks up to offset 0x14 — Debug Function
0x4001C000 SYSF blocks up to offset 0x11D — System /Flash Control
0x4001E000 SYSC blocks up to offset 0x4E2 — System Control
0x4001E180 EHC size 0x3 — Energy Harvesting Controller
0x40040000 PORT0 size 0xC — Port 0 Control Registers
0x40040020 PORT1 size 0xC — Port 1 Control Registers
0x40040040 PORT2 size 0x10 — Port 2 Control Registers
0x40040060 PORT3 size 0x10 — Port 3 Control Registers
0x40040080 PORT4 size 0xC — Port 4 Control Registers
0x400400A0 PORT5 size 0xC — Port 5 Control Registers
0x400400C0 PORT6 size 0xC — Port 6 Control Registers
0x400400E0 PORT7 size 0xC — Port 7 Control Registers
0x40040100 PORT8 size 0xC — Port 8 Control Registers
0x40040800 PFS blocks up to offset 0x504 — Pmn Pin Function Control Register
0x40041000 ELC blocks up to offset 0x60 — Event Link Controller
0x40041240 SCI2 blocks up to offset 0x1D — Serial Communication Interface 2
0x40041260 SCI3 blocks up to offset 0x1D — Serial Communication Interface 3
0x40041280 SCI4 blocks up to offset 0x1D — Serial Communication Interface 4
0x400412A0 SCI5 blocks up to offset 0x1D — Serial Communication Interface 5
0x40041320 SCI9 blocks up to offset 0x1D — Serial Communication Interface 9
0x40042000 POE blocks up to offset 0x104 — Port Output Enable Module for GPT
0x40044000 RTC blocks up to offset 0x8C — Realtime Clock
0x40044200 WDT blocks up to offset 0x9 — Watchdog Timer
0x40044400 IWDT blocks up to offset 0x6 — Independent Watchdog Timer
0x40044600 CAC blocks up to offset 0xC — Clock Frequency Accuracy Measurement Circuit
0x40047000 MSTP size 0xC — Module Stop Control B, C, D
0x40052000 TMR0 blocks up to offset 0xB — 8-Bit Timer 0
0x40052001 TMR1 blocks up to offset 0xB — 8-Bit Timer 1
0x40053000 IIC0 size 0x14 — Inter-Integrated Circuit 0
0x40053100 IIC1 size 0x14 — Inter-Integrated Circuit 1
0x40054100 DOC blocks up to offset 0x6 — Data Operation Circuit
0x40055000 GPT320 blocks up to offset 0x90 — General PWM 32-bit Timer 0
0x40055100 GPT321 blocks up to offset 0x90 — General PWM 32-bit Timer 1
0x40055200 GPT162 blocks up to offset 0x90 — General PWM 16-bit Timer 2
0x40055300 GPT163 blocks up to offset 0x90 — General PWM 16-bit Timer 3
0x40055400 GPT164 blocks up to offset 0x90 — General PWM 16-bit Timer 4
0x40055500 GPT165 blocks up to offset 0x90 — General PWM 16-bit Timer 5
0x40055FF0 GPT_OPS size 0x4 — Output Phase Switching Controller
0x4005C000 ADC140 blocks up to offset 0x1E0 — 14-bit A/D Converter
0x4005D000 TSN size 0x1 — Temperature Sensor
0x40070000 SCI0 size 0x1D — Serial Communication Interface 0
0x40070020 SCI1 size 0x1D — Serial Communication Interface 1
0x40070200 MLCD size 0x40 — MIP LCD Controller
0x40070800 GDT blocks up to offset 0x280 — 2D Graphics Data Conversion Circuit
0x40070F00 IRDA size 0x1 — IrDA Interface
0x40072000 SPI0 blocks up to offset 0x20 — Serial Peripheral Interface 0
0x40072100 SPI1 blocks up to offset 0x12 — Serial Peripheral Interface 1
0x40074000 CRC blocks up to offset 0xE — Cyclic Redundancy Check Calculator
0x40080000 KINT blocks up to offset 0x9 — Key Interrupt Function
0x40080400 CCC size 0xC — Clock Correction Circuit
0x40084000 AGT0 blocks up to offset 0x10 — Low Power Asynchronous General Purpose 8-bit Timer 0
0x40084100 AGT1 blocks up to offset 0x10 — Low Power Asynchronous General Purpose 8-bit Timer 1
0x40084200 AGTW0 blocks up to offset 0x14 — Low Power Asynchronous General Purpose 16-bit Timer 0
0x40084300 AGTW1 blocks up to offset 0x14 — Low Power Asynchronous General Purpose 16-bit Timer 1
0x40084400 LST size 0x8 — Low-Speed Clock Timer
0x40084480 WUPT size 0x5 — Wakeup Timer
0x40084500 DIL size 0x34 — Data Inversion and Logic operation
0x40084600 DIV blocks up to offset 0x94 — Divider
0x40086A00 VREF blocks up to offset 0x84 — Reference Voltage Generation Circuit
0x407FE000 FACI blocks up to offset 0xEA — Flash Application Command Interface
0x64000000 QSPI blocks up to offset 0x808 — Quad Serial Peripheral Interface

## Interrupts
{n} IEL{n} (ICU) (n=0..31) — ICU Interrupt {n}

## Licence text in the file
This software is supplied by Renesas Electronics Corporation and is only intended for use with Renesas products. No other uses are authorized. This software is owned by. Renesas Electronics Corporation and is protected under all applicable laws, including copyright laws. . THIS SOFTWARE IS PROVIDED "AS IS" AND RENESAS MAKES NO WARRANTIES REGARDING. THIS SOFTWARE, WHETHER EXPRESS, IMPLIED OR STATUTORY, INCLUDING BUT NOT LIMITED TO. WARRANTIES OF MERCHANTABILITY, FITNESS FOR A PARTICULAR PURPOSE AND NON-INFRINGEMENT. ALL SUCH WARRANTIES ARE EXPRESSLY DISCLAIMED. TO THE MAXIMUM EXTENT PERMITTED NOT. PROHIBITED BY LAW, NEITHER RENESAS ELECTRONICS CORPORATION NOR ANY OF ITS AFFILIATED. COMPANIES SHALL BE LIABLE FOR ANY DIRECT, INDIRECT, SPECIAL, INCIDENTAL OR CONSEQUENTIAL. DAMAGES FOR ANY REASON RELATED TO THIS SOFTWARE, EVEN IF RENESAS OR ITS AFFILIATES HAVE. BEEN ADVISED OF THE POSSIBILITY OF SUCH DAMAGES. . Renesas reserves the right, without notice, to make changes to this software and to discontinue the availability of this software. By using this software, you agree to the additional terms and conditions found by accessing the following link: http://www.renesas.com/disclaimer
